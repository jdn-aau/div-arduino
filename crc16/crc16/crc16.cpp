#include "crc16.h"

 // Beer license :-)
 /*****************************************************
* CRC16  package                                     *
*                                                    *
* origin : from here and there                       *
*  Created on: Dec 2013                              *
*      Author: jdn                                   *
*                                                    *
******************************************************
*                                                    *
*                                                    *
*                                                    *
* "THE BEER-WARE LICENSE" (frit efter PHK)           *
* <jdn@es.aau.dk> wrote this file. As long as you    *
* retain this notice you can do whatever you want    *
* with this stuff. If we meet some day, and you think*
* this stuff is worth it ...                         *
*  you can buy me a beer in return :-)               *
* or if you are real happy then ...                  *
* single malt will be well received :-)              *
*                                                    *
* Use it at your own risk - no warranty              *
*****************************************************/
// performance on arduino uno
// 20000 loops with add_crc
// on a  16B message takes  612 milliseconds
// on a  32B message takes 1175 milliseconds
// on a 100B message takes 3569 milliseconds
// on a 200B message takes 7091 millisecond
//
// so add_crc on one package takes
//   16B takes  30 usec
//   32B takes  59 usec
//  100B takes 178 usec
//  200B takes 354 usec
// ----------------------
// code ...
// char s[300]; // just for testing
//  Serial.print("start "); Serial.print(millis());
//  for (j=0; j < 20000; j++)
//    add_crc16(s,100);
//  erial.print("stop "); Serial.print(millis());
 

#define FCSINIT 0xFFFF
#define FCSGOOD 0xF0B8
#define FCSSIZE 2
/* 16 bit FCS */

/* 16 bit FCS lookup table per RFC1331 */

const uint16_t fcstab[] PROGMEM = {
  //int fcstab[256] = {
  0x0000, 0x1189, 0x2312, 0x329b, 0x4624, 0x57ad, 0x6536, 0x74bf,
  0x8c48, 0x9dc1, 0xaf5a, 0xbed3, 0xca6c, 0xdbe5, 0xe97e, 0xf8f7,
  0x1081, 0x0108, 0x3393, 0x221a, 0x56a5, 0x472c, 0x75b7, 0x643e,
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  0x7bc7, 0x6a4e, 0x58d5, 0x495c, 0x3de3, 0x2c6a, 0x1ef1, 0x0f78
};

//---------------------------------------------------------------------------
uint16_t calc_crc16(unsigned char *buf,int l, unsigned char *c1, unsigned char *c2)
{
  int i,indx;
  uint16_t j ,crc = FCSINIT;

  for(i=0 ; i < l ; i++) {
    indx = (crc ^ buf[i]) & 0xff;
    j = pgm_read_word_near(fcstab + indx);
    crc =  (crc >> 8) ^ j;
  }
  
  crc = ~crc;

  if (c1)
    *c1 = (unsigned char)(crc & 0xff);
  if (c2)
    *c2 = (unsigned char)((crc >> 8) & 0xff);

  return crc;
}
 
//---------------------------------------------------------------------------
void add_crc16(unsigned char *buf, int l)
{
  uint16_t crc;
  crc = calc_crc16(buf,l-2,0,0);

  buf[l-2] = crc & 0xff; /* Least significant byte of FCS */
  buf[l-1] = (crc >> 8) & 0xff; /* MSB of FCS */
}

//---------------------------------------------------------------------------
 char chk_crc16(unsigned char *buf, int l)
{
   uint16_t j; 
  j = calc_crc16(buf,l,0,0);
  if (~j == FCSGOOD)
     return (0); // ok
  else
    return(1); // not ok
}


